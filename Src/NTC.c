/*
 * NTC.c
 *
 *  Created on: 2019年12月10日
 *      Author: Breuning
 */

#include "NTC.h"
#include "adc.h"
#include "SensorAnalysis.h"

const ntcData_t ntc_3950_data[] =
{
		{	-20	,	95.337	},
		{	-19.5	,	92.6559	},
		{	-19	,	90.058	},
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		{	100	,	0.663	},
};

BOOL NTC_ifAvailable(float valueOfResistance )
{
	if ((valueOfResistance > 90) || (valueOfResistance < 0.4))
	{
		return FALSE;
	}
	return TRUE;
}

//获取NTC热敏电阻数值 (PC2-ADC3 电阻信号)
void GetWaterTemFromNTC(void)
{
	double r = 0;
	double t = 0;

 	r = (double)ADC_Average(&hadc3, 10);          //10次数据的平均值
 	r = (double)(r * 3.3 / 4095.0);               //采集到的实际电压值
	r = NTC_PUSH_UP_RESISTOR_KR / (3.3/r - 1);    //电压值转化为电阻值

	if(NTC_ifAvailable(r) != TRUE)
		return;
	else
		Tick_GetSensorData = HAL_GetTick();


	if(r > 95.3)
	{
		t = -20.0;
	}

	if(r < 0.673)
	{
		t = 100.0;
	}

	for (uint32_t i = 0; i < sizeof(ntc_3950_data) / sizeof(ntcData_t) - 1; i++)
	{
		if((r <= ntc_3950_data[i].r) && ( r >= ntc_3950_data[i + 1].r))
		{

			t = (ntc_3950_data[i + 1].t - ntc_3950_data[i].t) / (ntc_3950_data[i].r - ntc_3950_data[i + 1].r);
			t *= (r - ntc_3950_data[i + 1].r);
			t +=  ntc_3950_data[i].t;
			t += 0.05;
		}
	}

	Sensor_Data.WaterTemperature = (uint16_t)(t * 10 - 20);               //温度值放大10倍传输, 根据实际测量得到NTC偏高2度左右
}

